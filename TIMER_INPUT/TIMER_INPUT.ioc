# file: TIMER_INPUT.ioc
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Mcu.Family=STM32F4
Mcu.Name=STM32F411V(C-E)Tx
Mcu.Package=LQFP100
NVIC.PriorityGroup=NVIC_PRIORITYGROUP_4
PA13.Mode=Serial_Wire
PA13.Signal=SYS_JTMS-SWDIO
PA14.Mode=Serial_Wire
PA14.Signal=SYS_JTCK-SWCLK
ProjectManager.HeapSize=0x200
ProjectManager.StackSize=0x400
ProjectManager.TargetToolchain=STM32CubeIDE
RCC.AHBFreq_Value=16000000
RCC.APB1Freq_Value=16000000
RCC.APB2Freq_Value=16000000
RCC.CortexFreq_Value=16000000
RCC.HSE_VALUE=25000000
RCC.HSI_VALUE=16000000
RCC.LSE_VALUE=32768
RCC.SYSCLKFreq_VALUE=16000000
RCC.VCOOutputFreq_Value=192000000
board=custom

// file: Core/Src/main.c
/* USER CODE BEGIN Header */
/**
  ******************************************************************************
  * @file           : main.c
  * @brief          : Main program body
  ******************************************************************************
  * @attention
  *
  * Copyright (c) 2023 STMicroelectronics.
  * All rights reserved.
  *
  * This software is licensed under terms that can be found in the LICENSE file
  * in the root directory of this software component.
  * If no LICENSE file comes with this software, it is provided AS-IS.
  *
  ******************************************************************************
  */
/* USER CODE END Header */
#include "main.h"
#include <stdint.h>

void SystemClock_Config(void);
static void MX_GPIO_Init(void);

/* USER CODE BEGIN 0 */

uint32_t systick_cnt = 0;
volatile char rx_buffer[5852] = {0};
volatile char recv_data_done_flag = 0;
void SysTick_Handler()
{
	systick_cnt++;
}
void system_tick_init()
{
	uint32_t* CSR = (uint32_t* )0xe000e010;
	uint32_t* RVR = (uint32_t* )0xe000e014;
	*RVR = 15999;
	*CSR |= (1<<1)|(1<<0)|(1<<2);
}

void Custom_delay(uint32_t mSec)
{
	systick_cnt = 0;
	while(systick_cnt < mSec);
}

void TIM4_PWM_Init()
{
	//PWM T = 1s, do rong xung = 50%
	__HAL_RCC_GPIOD_CLK_ENABLE();
	uint32_t* GPIOD_MODER = (uint32_t*)(0x40020c00);
	*GPIOD_MODER |= (0b10 << 24);
	uint32_t* GPIOD_AFRH = (uint32_t*)(0x40020c24);
	*GPIOD_AFRH |= (2 << 16);

	__HAL_RCC_TIM4_CLK_ENABLE();
	uint32_t* TIM4_ARR = (uint32_t*)(0x4000082c);
	uint32_t* TIM4_PSC = (uint32_t*)(0x40000828);
	uint32_t* TIM4_CCR1 = (uint32_t*)(0x40000834);
	*TIM4_ARR = 100 - 1;
	*TIM4_PSC = 160 - 1;
	*TIM4_CCR1 = 25;

	uint32_t* TIM4_CR1 = (uint32_t*)(0x40000800);
	uint32_t* TIM4_CCMR1 = (uint32_t*)(0x40000818);
	uint32_t* TIM4_CCER = (uint32_t*)(0x40000820);

	*TIM4_CCMR1 &= ~(0b11<<0);  // set mode in output compare
	*TIM4_CCMR1 |= (0b110 << 4); // set CC1 mode in PWM1

	*TIM4_CCER |= (1<<0); // enable channel 1

	*TIM4_CR1 |= 1; // enable counter
}

void Modify_PWM(uint8_t value)
{
	uint32_t* CCR1 = (uint32_t*)(0x40000834);
	*CCR1 = value;

}
void TIM5_CAPTURE_Init()
{
	//set PA0 inalternate function AF02 (TIM5_CH1 )
	__HAL_RCC_GPIOA_CLK_ENABLE();
	uint32_t* GPIOA_MODER = (uint32_t*)(0x40020000);
	*GPIOA_MODER &= ~(0b11 << 0);
	*GPIOA_MODER |= (0b10 << 0);
	uint32_t* GPIOA_AFRL = (uint32_t*)(0x40020020);
	*GPIOA_AFRL |= (2 << 0);

	__HAL_RCC_TIM5_CLK_ENABLE();
	// set counter
	uint32_t* TIM5_ARR = (uint32_t*)(0x40000c2c);
	uint32_t* TIM5_PSC = (uint32_t*)(0x40000c28);
	*TIM5_ARR = 0xffff;
	*TIM5_PSC = 16-1; // 1cnt -> 1us

	uint32_t* TIM5_CCMR1 = (uint32_t*)(0x40000c18);
	uint32_t* TIM5_CCER = (uint32_t*)(0x40000c20);
	// setup capture channel 1
	*TIM5_CCMR1 |= (0b01<<0); // set CH1 map TI1
	*TIM5_CCER &= ~((1<<1) | (1<<3));  //rising for channel 1

	// setup capture channel 2
	*TIM5_CCMR1 |= (0b10<<8); // set CH2 map TI1
	*TIM5_CCER &= ~(1<<7);  //falling for channel 2
	*TIM5_CCER |= (1<<5);

	//reset counter to 0 when rising
	uint32_t* TIM5_SMCR = (uint32_t*)(0x40000c08);
	*TIM5_SMCR |= 0b100; //set reset mode
	*TIM5_SMCR |= (0b101 << 4);

	// enable channel 1, channel 2, counter
	*TIM5_CCER |= (1<<0) | (1<<4);
	uint32_t* TIM5_CR1 = (uint32_t*)(0x40000c00);
	*TIM5_CR1 |= 1;
}

int Get_freq()
{
	uint32_t* TIM5_CCR1 = (uint32_t*)(0x40000c34);
	return *TIM5_CCR1;
}
int Get_pulse_width()
{
	uint32_t* TIM5_CCR2 = (uint32_t*)(0x40000c38);
	return *TIM5_CCR2;
}
/* USER CODE END 0 */

int freq = 0;
int pulse_width = 0;
int main()
{

  /* MCU Configuration--------------------------------------------------------*/

  /* Reset of all peripherals, Initializes the Flash interface and the Systick. */
  HAL_Init();
  system_tick_init();
  TIM4_PWM_Init();
  Modify_PWM(50);
  TIM5_CAPTURE_Init();

  /* Configure the system clock */
  SystemClock_Config();

  /* Initialize all configured peripherals */
  MX_GPIO_Init();

  /* Infinite loop */
  while (1)
  {
	  freq = Get_freq();
	  pulse_width = Get_pulse_width();
	  Custom_delay(100);
    /* USER CODE BEGIN 3 */
  }
  return 0;
  /* USER CODE END 3 */
}

void SystemClock_Config(void)
{
  RCC_OscInitTypeDef RCC_OscInitStruct = {0};
  RCC_ClkInitTypeDef RCC_ClkInitStruct = {0};

  /** Configure the main internal regulator output voltage
  */
  __HAL_RCC_PWR_CLK_ENABLE();
  __HAL_PWR_VOLTAGESCALING_CONFIG(PWR_REGULATOR_VOLTAGE_SCALE1);

  /** Initializes the RCC Oscillators according to the specified parameters
  * in the RCC_OscInitTypeDef structure.
  */
  RCC_OscInitStruct.OscillatorType = RCC_OSCILLATORTYPE_HSI;
  RCC_OscInitStruct.HSIState = RCC_HSI_ON;
  RCC_OscInitStruct.HSICalibrationValue = RCC_HSICALIBRATION_DEFAULT;
  RCC_OscInitStruct.PLL.PLLState = RCC_PLL_NONE;
  if (HAL_RCC_OscConfig(&RCC_OscInitStruct) != HAL_OK)
  {
    Error_Handler();
  }

  /** Initializes the CPU, AHB and APB buses clocks
  */
  RCC_ClkInitStruct.ClockType = RCC_CLOCKTYPE_HCLK|RCC_CLOCKTYPE_SYSCLK
                              |RCC_CLOCKTYPE_PCLK1|RCC_CLOCKTYPE_PCLK2;
  RCC_ClkInitStruct.SYSCLKSource = RCC_SYSCLKSOURCE_HSI;
  RCC_ClkInitStruct.AHBCLKDivider = RCC_SYSCLK_DIV1;
  RCC_ClkInitStruct.APB1CLKDivider = RCC_HCLK_DIV1;
  RCC_ClkInitStruct.APB2CLKDivider = RCC_HCLK_DIV1;

  if (HAL_RCC_ClockConfig(&RCC_ClkInitStruct, FLASH_LATENCY_0) != HAL_OK)
  {
    Error_Handler();
  }
}

static void MX_GPIO_Init(void)
{

  /* GPIO Ports Clock Enable */
  __HAL_RCC_GPIOA_CLK_ENABLE();

}

void Error_Handler(void)
{
  __disable_irq();
  while (1)
  {
  }
}
