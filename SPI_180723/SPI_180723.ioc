# file: SPI_180723.ioc
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Mcu.Family=STM32F4
Mcu.Name=STM32F411V(C-E)Tx
Mcu.Package=LQFP100
NVIC.PriorityGroup=NVIC_PRIORITYGROUP_4
PA13.Mode=Serial_Wire
PA13.Signal=SYS_JTMS-SWDIO
PA14.Mode=Serial_Wire
PA14.Signal=SYS_JTCK-SWCLK
ProjectManager.HeapSize=0x200
ProjectManager.StackSize=0x400
ProjectManager.TargetToolchain=STM32CubeIDE
RCC.AHBFreq_Value=16000000
RCC.APB1Freq_Value=16000000
RCC.APB2Freq_Value=16000000
RCC.CortexFreq_Value=16000000
RCC.HSE_VALUE=25000000
RCC.HSI_VALUE=16000000
RCC.LSE_VALUE=32768
RCC.SYSCLKFreq_VALUE=16000000
RCC.VCOOutputFreq_Value=192000000
board=custom

// file: Core/Src/main.c
/* USER CODE BEGIN Header */
/**
  ******************************************************************************
  * @file           : main.c
  * @brief          : Main program body
  ******************************************************************************
  * @attention
  *
  * Copyright (c) 2023 STMicroelectronics.
  * All rights reserved.
  *
  * This software is licensed under terms that can be found in the LICENSE file
  * in the root directory of this software component.
  * If no LICENSE file comes with this software, it is provided AS-IS.
  *
  ******************************************************************************
  */
/* USER CODE END Header */
#include "main.h"
#include <stdint.h>

void SystemClock_Config(void);
static void MX_GPIO_Init(void);

/* USER CODE BEGIN 0 */
#define SPI_ADDRESS_BASE   0x40013000
void active_slave()
{
	//set PE3 LOW
	__HAL_RCC_GPIOE_CLK_ENABLE();
	uint32_t* GPIOE_ODR = (uint32_t*)(0x40021000 + 0x14);
	*GPIOE_ODR &= (0 << 3);
}

void inactive_slave()
{
	//set PE3 HIGH
	__HAL_RCC_GPIOE_CLK_ENABLE();
	uint32_t* GPIOE_ODR = (uint32_t*)(0x40021000 + 0x14);
	*GPIOE_ODR |= (1 << 3);
}

void SPI_Init()
{
	__HAL_RCC_GPIOA_CLK_ENABLE();
	__HAL_RCC_GPIOE_CLK_ENABLE();
	//set GPIO PA5, 6, 7 alternate function mode
	uint32_t* GPIOA_MODER = (uint32_t*)(0x40020000 + 0x00);
	*GPIOA_MODER |= (0b10 << 10) | (0b10 << 12) | (0b10 << 14);  //set PA5, 6, 7 in alternate function
	uint32_t* GPIOA_AFRL = (uint32_t*)(0x40020000 + 0x20);
	*GPIOA_AFRL &= ~(0xfff << 20);
	*GPIOA_AFRL |= (0b0101 << 20) | (0b0101 << 24) | (0b0101 << 28);

	// set PE3 output mode
	uint32_t* GPIOE_MODER = (uint32_t*)(0x40021000 + 0x00);
	*GPIOE_MODER |= (0b01 << 6);

	inactive_slave();
	__HAL_RCC_SPI1_CLK_ENABLE();
	uint32_t* CR1 = (uint32_t*)(SPI_ADDRESS_BASE + 0x00);
	*CR1 |= (1<<2); // set stm32 as master
	*CR1 |= 0b100 << 3;
	*CR1 |= (1<<8) | (1<<9);
	*CR1 |= 1<<6;
}
 uint8_t SPI_READ(uint8_t address)
 {
	 uint32_t* SR = (uint32_t*)(SPI_ADDRESS_BASE + 0x08);
	 uint32_t* DR = (uint32_t*)(SPI_ADDRESS_BASE + 0x0C);

	 active_slave();

	 //while(((*SR >> 7) & 1) == 1);
	 while(((*SR >> 1) & 1) == 0);
	 *DR = address | (1 <<7);
	 while(((*SR >> 1) & 1) == 1);
	 while(((*SR >> 0) & 1) == 0);
	 while(((*SR >> 7) & 1) == 1);
	 uint8_t temp = *DR; // clear rx buffer
	 while(((*SR >> 1) & 1) == 0);
	 *DR = 0x00;   // send fake data to create clock
	 while(((*SR >> 1) & 1) == 1);
	 while(((*SR >> 0) & 1) == 0);
	 while(((*SR >> 7) & 1) == 1);
	 temp = *DR;

	 inactive_slave();

	 return temp;
 }

 void SPI_Write(uint8_t address, uint8_t data)
 {
	 uint32_t* SR = (uint32_t*)(SPI_ADDRESS_BASE + 0x08);
	 uint32_t* DR = (uint32_t*)(SPI_ADDRESS_BASE + 0x0C);

	 active_slave();

	 while(((*SR >> 7) & 1) == 1);
	 while(((*SR >> 1) & 1) == 0);
	 *DR = (1<<7)|address;
	 while(((*SR >> 1) & 1) == 1);
	 while(((*SR >> 0) & 1) == 0);
	 while(((*SR >> 7) & 1) == 1);
	 uint8_t temp = *DR; // clear rx buffer
	 while(((*SR >> 1) & 1) == 0);
	 *DR = data;   // send fake data to create clock
	 while(((*SR >> 1) & 1) == 1);
	 while(((*SR >> 0) & 1) == 0);
	 while(((*SR >> 7) & 1) == 1);
	 temp = *DR;

	 inactive_slave();

	 return temp;
 }
/* USER CODE END 0 */

int main(void)
{

  /* MCU Configuration--------------------------------------------------------*/

  /* Reset of all peripherals, Initializes the Flash interface and the Systick. */
  HAL_Init();

  /* Configure the system clock */
  SystemClock_Config();

  /* Initialize all configured peripherals */
  MX_GPIO_Init();
  SPI_Init();
  uint8_t gyro_id = SPI_READ(0x0f);

  /* Infinite loop */
  while (1)
  {

  }
}

void SystemClock_Config(void)
{
  RCC_OscInitTypeDef RCC_OscInitStruct = {0};
  RCC_ClkInitTypeDef RCC_ClkInitStruct = {0};

  /** Configure the main internal regulator output voltage
  */
  __HAL_RCC_PWR_CLK_ENABLE();
  __HAL_PWR_VOLTAGESCALING_CONFIG(PWR_REGULATOR_VOLTAGE_SCALE1);

  /** Initializes the RCC Oscillators according to the specified parameters
  * in the RCC_OscInitTypeDef structure.
  */
  RCC_OscInitStruct.OscillatorType = RCC_OSCILLATORTYPE_HSI;
  RCC_OscInitStruct.HSIState = RCC_HSI_ON;
  RCC_OscInitStruct.HSICalibrationValue = RCC_HSICALIBRATION_DEFAULT;
  RCC_OscInitStruct.PLL.PLLState = RCC_PLL_NONE;
  if (HAL_RCC_OscConfig(&RCC_OscInitStruct) != HAL_OK)
  {
    Error_Handler();
  }

  /** Initializes the CPU, AHB and APB buses clocks
  */
  RCC_ClkInitStruct.ClockType = RCC_CLOCKTYPE_HCLK|RCC_CLOCKTYPE_SYSCLK
                              |RCC_CLOCKTYPE_PCLK1|RCC_CLOCKTYPE_PCLK2;
  RCC_ClkInitStruct.SYSCLKSource = RCC_SYSCLKSOURCE_HSI;
  RCC_ClkInitStruct.AHBCLKDivider = RCC_SYSCLK_DIV1;
  RCC_ClkInitStruct.APB1CLKDivider = RCC_HCLK_DIV1;
  RCC_ClkInitStruct.APB2CLKDivider = RCC_HCLK_DIV1;

  if (HAL_RCC_ClockConfig(&RCC_ClkInitStruct, FLASH_LATENCY_0) != HAL_OK)
  {
    Error_Handler();
  }
}

static void MX_GPIO_Init(void)
{

  /* GPIO Ports Clock Enable */
  __HAL_RCC_GPIOA_CLK_ENABLE();

}

void Error_Handler(void)
{
  __disable_irq();
  while (1)
  {
  }
}
